## board/freescale/mx6sxrtssd/Kconfig
```kconfig
if TARGET_MX6SXRTSSD

config SYS_BOARD
	default "mx6sxrtssd"

config SYS_VENDOR
	default "freescale"

config SYS_CONFIG_NAME
	default "mx6sxrtssd"

endif
```
